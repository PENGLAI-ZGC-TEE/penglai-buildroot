## br2-external/configs/zgc_tee_nanhuv3a_fpga_defconfig
```kconfig
BR2_riscv=y
BR2_RISCV_64=y
BR2_CCACHE=y
BR2_TOOLCHAIN_BUILDROOT_GLIBC=y
BR2_KERNEL_HEADERS_5_10=y
BR2_TARGET_GENERIC_HOSTNAME="zgc-tee-nanhuv3a-fpga"
BR2_TARGET_GENERIC_ISSUE="ZGC_TEE nanhuv3a FPGA Buildroot"
BR2_ROOTFS_OVERLAY="$(BR2_EXTERNAL_ZGC_TEE_PATH)/board/nanhuv3a/fpga/overlay"
BR2_ROOTFS_POST_BUILD_SCRIPT="$(BR2_EXTERNAL_ZGC_TEE_PATH)/board/nanhuv3a/fpga/post_build.sh"
BR2_ROOTFS_POST_IMAGE_SCRIPT="$(BR2_EXTERNAL_ZGC_TEE_PATH)/board/nanhuv3a/fpga/post_image.sh"
BR2_GLOBAL_PATCH_DIR="$(BR2_EXTERNAL_ZGC_TEE_PATH)/patches"
BR2_LINUX_KERNEL=y
BR2_LINUX_KERNEL_CUSTOM_GIT=y
BR2_LINUX_KERNEL_CUSTOM_REPO_URL="git@github.com:PENGLAI-ZGC-TEE/debian-linux-kernel.git"
BR2_LINUX_KERNEL_CUSTOM_REPO_VERSION="2ba19f6b7733c5c2db4822be578c03e7f2405baf"
BR2_LINUX_KERNEL_DEFCONFIG="nanhu_fpga"
BR2_LINUX_KERNEL_CONFIG_FRAGMENT_FILES="$(BR2_EXTERNAL_ZGC_TEE_PATH)/board/nanhuv3a/fpga/linux.fragment"
BR2_LINUX_KERNEL_IMAGE=y
BR2_TARGET_ROOTFS_CPIO=y
BR2_TARGET_ROOTFS_INITRAMFS=y
BR2_TARGET_ROOTFS_CPIO_GZIP=y
BR2_TARGET_OPENSBI=y
BR2_TARGET_OPENSBI_CUSTOM_GIT=y
BR2_TARGET_OPENSBI_CUSTOM_REPO_URL="git@github.com:PENGLAI-ZGC-TEE/opensbi.git"
BR2_TARGET_OPENSBI_CUSTOM_REPO_VERSION="572bfedd6fbf2800b5857d5eb3d0cc66281c0da2"
BR2_TARGET_OPENSBI_PLAT="generic"
BR2_TARGET_OPENSBI_LINUX_PAYLOAD=y
BR2_TARGET_OPENSBI_ADDITIONAL_VARIABLES="PLATFORM_RISCV_ISA=rv64imafdc_zicsr_zifencei FW_FDT_PATH=$(BINARIES_DIR)/platform.dtb"
BR2_PACKAGE_BUSYBOX=y
BR2_PACKAGE_PLATFORM_DTB=y
BR2_PACKAGE_PLATFORM_DTB_PLATFORM="fpga"
BR2_PACKAGE_PENGLAI_DRIVER=y
BR2_PACKAGE_PENGLAI_SDK=y
```

## br2-external/configs/zgc_tee_nanhuv3a_nemu_defconfig
```kconfig
BR2_riscv=y
BR2_RISCV_64=y
BR2_CCACHE=y
BR2_TOOLCHAIN_BUILDROOT_GLIBC=y
BR2_KERNEL_HEADERS_5_10=y
BR2_SYSTEM_DHCP="eth0"
BR2_TARGET_GENERIC_HOSTNAME="zgc-tee-nanhuv3a-nemu"
BR2_TARGET_GENERIC_ISSUE="ZGC_TEE nanhuv3a NEMU Buildroot"
BR2_ROOTFS_OVERLAY="$(BR2_EXTERNAL_ZGC_TEE_PATH)/board/nanhuv3a/nemu/overlay"
BR2_ROOTFS_POST_BUILD_SCRIPT="$(BR2_EXTERNAL_ZGC_TEE_PATH)/board/nanhuv3a/nemu/post_build.sh"
BR2_ROOTFS_POST_IMAGE_SCRIPT="$(BR2_EXTERNAL_ZGC_TEE_PATH)/board/nanhuv3a/nemu/post_image.sh"
BR2_GLOBAL_PATCH_DIR="$(BR2_EXTERNAL_ZGC_TEE_PATH)/patches"
BR2_LINUX_KERNEL=y
BR2_LINUX_KERNEL_CUSTOM_GIT=y
BR2_LINUX_KERNEL_CUSTOM_REPO_URL="git@github.com:PENGLAI-ZGC-TEE/debian-linux-kernel.git"
BR2_LINUX_KERNEL_CUSTOM_REPO_VERSION="2ba19f6b7733c5c2db4822be578c03e7f2405baf"
BR2_LINUX_KERNEL_DEFCONFIG="nanhu_fpga"
BR2_LINUX_KERNEL_CONFIG_FRAGMENT_FILES="$(BR2_EXTERNAL_ZGC_TEE_PATH)/board/nanhuv3a/nemu/linux.fragment"
BR2_LINUX_KERNEL_IMAGE=y
BR2_TARGET_ROOTFS_CPIO=y
BR2_TARGET_ROOTFS_INITRAMFS=y
BR2_TARGET_ROOTFS_CPIO_GZIP=y
BR2_TARGET_OPENSBI=y
BR2_TARGET_OPENSBI_CUSTOM_GIT=y
BR2_TARGET_OPENSBI_CUSTOM_REPO_URL="git@github.com:PENGLAI-ZGC-TEE/opensbi.git"
BR2_TARGET_OPENSBI_CUSTOM_REPO_VERSION="572bfedd6fbf2800b5857d5eb3d0cc66281c0da2"
BR2_TARGET_OPENSBI_PLAT="generic"
BR2_TARGET_OPENSBI_LINUX_PAYLOAD=y
BR2_TARGET_OPENSBI_ADDITIONAL_VARIABLES="PLATFORM_RISCV_ISA=rv64imafdc_zicsr_zifencei FW_FDT_PATH=$(BR2_EXTERNAL_ZGC_TEE_PATH)/board/nanhuv3a/nemu/system.dtb NEMU_SKIP_SPMP_ENABLE=1"
BR2_PACKAGE_BUSYBOX=y
BR2_PACKAGE_PENGLAI_HELLO=y
BR2_PACKAGE_PENGLAI_DRIVER=y
BR2_PACKAGE_PENGLAI_SDK=y
BR2_PACKAGE_POWEROFF=y
```

## br2-external/package/Config.in
```kconfig
menu "Penglai packages"
source "$BR2_EXTERNAL_ZGC_TEE_PATH/package/platform-dtb/Config.in"
source "$BR2_EXTERNAL_ZGC_TEE_PATH/package/penglai-driver/Config.in"
source "$BR2_EXTERNAL_ZGC_TEE_PATH/package/penglai-sdk/Config.in"
source "$BR2_EXTERNAL_ZGC_TEE_PATH/package/crypto_demos_scalar/Config.in"
endmenu
```

## br2-external/package/crypto_demos_scalar/Config.in
```kconfig
config BR2_PACKAGE_CRYPTO_DEMOS_SCALAR
	bool "crypto_demos_scalar"
	help
	  Build and install RISC-V scalar crypto demo programs.
```

## br2-external/package/penglai-driver/Config.in
```kconfig
config BR2_PACKAGE_PENGLAI_DRIVER
	bool "penglai-driver"
	depends on BR2_LINUX_KERNEL
	help
	  Build and install the Penglai kernel module for the NEMU image.
```

## br2-external/package/penglai-sdk/Config.in
```kconfig
config BR2_PACKAGE_PENGLAI_SDK
	bool "penglai-sdk"
	depends on BR2_TOOLCHAIN_HAS_THREADS
	help
	  Build the embedded Penglai SDK demos and install /root/host and /root/prime.
```

## br2-external/package/penglai/hello/Config.in
```kconfig
config BR2_PACKAGE_PENGLAI_HELLO
	bool "penglai-hello"
	help
	  Legacy riscv-rootfs hello sample migrated into Buildroot.
```

## br2-external/package/platform-dtb/Config.in
```kconfig
config BR2_PACKAGE_PLATFORM_DTB
	bool "platform-dtb"
	select BR2_PACKAGE_HOST_DTC
	help
	  Build the device tree blob used by the selected platform.

config BR2_PACKAGE_PLATFORM_DTB_PLATFORM
	string "Platform DTB platform"
	default "nemu"
	depends on BR2_PACKAGE_PLATFORM_DTB
	help
	  Platform directory under board/nanhuv3a that provides system.dts.
```

## br2-external/package/poweroff/Config.in
```kconfig
config BR2_PACKAGE_POWEROFF
	bool "poweroff"
	help
	  Legacy riscv-rootfs poweroff sample migrated into Buildroot.
```
